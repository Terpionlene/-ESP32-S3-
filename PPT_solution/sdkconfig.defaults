## PPT_solution/sdkconfig.defaults
```kconfig
CONFIG_IDF_TARGET="esp32s3"
CONFIG_ESP32S3_DEFAULT_CPU_FREQ_240=y
CONFIG_ESPTOOLPY_FLASHSIZE_16MB=y
CONFIG_PARTITION_TABLE_SINGLE_APP=y
CONFIG_ESP_CONSOLE_USB_SERIAL_JTAG=y
CONFIG_HTTPD_ENABLE=y
```

## main/Kconfig.projbuild
```kconfig
menu "API Configuration"
    config DEEPSEEK_API_KEY
        string "DeepSeek API Key"
        default "your_deepseek_api_key_here"
        help
            Your DeepSeek API key for AI chat functionality.

    config BAIDU_API_KEY
        string "Baidu API Key"
        default "your_baidu_api_key_here"
        help
            Your Baidu API key for ASR/TTS functionality.

    config BAIDU_SECRET_KEY
        string "Baidu Secret Key"
        default "your_baidu_secret_key_here"
        help
            Your Baidu secret key for ASR/TTS functionality.
endmenu
```

## sdkconfig.defaults
```kconfig
# Memory Configuration for ESP32-S3-WROOM2-N32R16V
# N32 = 32MB Flash, R16 = 16MB PSRAM

# Flash Configuration
CONFIG_ESPTOOLPY_FLASH_SIZE_32MB=y

# PSRAM Configuration
CONFIG_SPIRAM=y
CONFIG_SPIRAM_MODE_OCT=y
CONFIG_SPIRAM_TYPE_ESPPSRAM64=y
CONFIG_SPIRAM_SPEED_80M=y
CONFIG_SPIRAM_ALLOW_BSS_SEG_EXTERNAL_MEMORY=y
CONFIG_SPIRAM_ALLOW_NOINIT_SEG_EXTERNAL_MEMORY=y
CONFIG_SPIRAM_RODATA=y
CONFIG_SPIRAM_FETCH_INSTRUCTIONS=y

# Optimization Configuration
CONFIG_COMPILER_OPTIMIZATION_SIZE=y
CONFIG_OPTIMIZATION_LEVEL_RELEASE=y

# LVGL Font Configuration
CONFIG_LV_FONT_MONTSERRAT_16=y
CONFIG_LV_FONT_MONTSERRAT_16_SYMBOLS=y
CONFIG_LV_FONT_MONTSERRAT_22=y
CONFIG_LV_FONT_MONTSERRAT_22_SYMBOLS=y

# Partition Table Configuration
CONFIG_PARTITION_TABLE_SINGLE_APP_LARGE=y

# ESP-TLS Configuration - Skip certificate verification (like official SDK)
CONFIG_ESP_TLS_INSECURE=y
CONFIG_ESP_TLS_SKIP_SERVER_CERT_VERIFY=y

# API Keys - Replace with your own keys before building
CONFIG_DEEPSEEK_API_KEY="your_deepseek_api_key_here"
CONFIG_BAIDU_API_KEY="your_baidu_api_key_here"
CONFIG_BAIDU_SECRET_KEY="your_baidu_secret_key_here"
```
